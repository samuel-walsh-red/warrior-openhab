## build/conf/bblayers.conf
```bitbake
# POKY_BBLAYERS_CONF_VERSION is increased each time build/conf/bblayers.conf
# changes incompatibly
POKY_BBLAYERS_CONF_VERSION = "2"

BUILDROOT := "${@os.path.abspath(os.path.dirname(d.getVar('FILE', True)) + '/../..')}"

BBPATH = "${TOPDIR}"
BBFILES ?= ""

BBLAYERS ?= " \
  ${BUILDROOT}/meta \
  ${BUILDROOT}/meta-poky \
  ${BUILDROOT}/meta-yocto-bsp \
  ${BUILDROOT}/meta-raspberrypi \
  ${BUILDROOT}/meta-webstuff \
  ${BUILDROOT}/meta-qt5 \
  ${BUILDROOT}/meta-java \
  ${BUILDROOT}/meta-openembedded/meta-oe \
  ${BUILDROOT}/meta-openembedded/meta-multimedia \
  ${BUILDROOT}/meta-openembedded/meta-python \
  ${BUILDROOT}/meta-openembedded/meta-networking \
  "
```
